/*
  RFID Door Lock
  Arduino Uno + RC522 RFID + 12V lock-style solenoid + buzzer

  Circuito.io recipe:
  https://www.circuito.io/app?components=11021,761981,842876,956215

  The wiring and the bundled RFID/SolenoidLock/Buzzer libraries were
  generated by circuito.io for exactly this component set. This sketch
  replaces their menu/test firmware with real access-control logic.

  Behaviour
  ---------
  - Waits for a MIFARE card on the RC522.
  - Compares the 4-byte UID with AUTHORIZED_UIDS.
  - Valid card: two short beeps, solenoid unlocks for UNLOCK_MS, then re-locks.
  - Unknown card: one long beep, lock stays closed.
  - Every scanned UID is printed on Serial Monitor (9600 baud) so a new
    card can be enrolled by copying its UID into AUTHORIZED_UIDS.

  Safety
  ------
  - The solenoid is powered from 12V, not from the Arduino 5V pin.
  - A 1N4001 flyback diode is mandatory across the solenoid.
  - The MOSFET gate has a 10K pull-down so the lock stays locked during reset.
  - This is UID-only access control: fine for a demo, not for real security.
    UIDs can be cloned. Use MIFARE authentication or a secure reader for
    anything that actually protects a building.
*/

#include <Arduino.h>
#include <string.h>

#include "Buzzer.h"
#include "SolenoidLock.h"
#include "RFID.h"

// ---------------------------------------------------------------------------
// Pin map generated by circuito.io for this recipe. Do not change these
// unless you change the Circuito.io wiring too.
// ---------------------------------------------------------------------------
#define BUZZER_PIN_SIG        2
#define SOLENOIDLOCK_PIN_GND  3
#define RFID_PIN_RST          4
#define RFID_PIN_SDA          10   // RC522 SS / SDA

// How long the door stays unlocked after a valid card (milliseconds).
const uint32_t UNLOCK_MS = 3000;

// Prevent a held card from re-triggering the lock immediately.
const uint32_t SCAN_COOLDOWN_MS = 1200;

// Bench test only: set to 1 to let ANY card open the lock.
// Set back to 0 before using the project as an actual lock.
#define ALLOW_ANY_CARD 0

// ---------------------------------------------------------------------------
// Enroll cards here. Scan a card with the Serial Monitor open, then copy
// the printed "Card UID" bytes into this table.
//
// Example: if the monitor prints "Card UID: A1 B2 C3 D4", write:
//   {0xA1, 0xB2, 0xC3, 0xD4},
// ---------------------------------------------------------------------------
const uint8_t AUTHORIZED_UIDS[][4] = {
  {0xDE, 0xAD, 0xBE, 0xEF},   // placeholder — replace with your card
};

const size_t AUTHORIZED_COUNT = sizeof(AUTHORIZED_UIDS) / sizeof(AUTHORIZED_UIDS[0]);

// Objects instantiated with the same pins as the generated Circuito.io code.
Buzzer buzzer(BUZZER_PIN_SIG);
SolenoidLock doorLock(SOLENOIDLOCK_PIN_GND);
RFID rfid(RFID_PIN_SDA, RFID_PIN_RST);

unsigned long lastScanAt = 0;

void printUid(const uint8_t *uid) {
  for (uint8_t i = 0; i < 4; i++) {
    if (uid[i] < 0x10) Serial.print('0');
    Serial.print((unsigned int)uid[i], HEX);
    if (i < 3) Serial.print(' ');
  }
}

bool isAuthorized(const uint8_t *uid) {
#if ALLOW_ANY_CARD
  return true;
#else
  for (size_t i = 0; i < AUTHORIZED_COUNT; i++) {
    if (memcmp(uid, AUTHORIZED_UIDS[i], 4) == 0) {
      return true;
    }
  }
  return false;
#endif
}

void beep(uint16_t onMs, uint16_t gapMs, uint8_t times) {
  for (uint8_t i = 0; i < times; i++) {
    buzzer.on();
    delay(onMs);
    buzzer.off();
    if (i + 1 < times) {
      delay(gapMs);
    }
  }
}

void grantAccess() {
  Serial.println(F("ACCESS GRANTED"));
  beep(70, 60, 2);

  doorLock.on();          // energize solenoid: door unlocks
  delay(UNLOCK_MS);
  doorLock.off();         // spring returns the lock to the closed position

  Serial.println(F("LOCKED"));
}

void denyAccess() {
  Serial.println(F("ACCESS DENIED"));
  beep(600, 0, 1);
}

void setup() {
  Serial.begin(9600);
  Serial.println(F("RFID door lock booting..."));

  rfid.init();
  doorLock.off();
  buzzer.off();

  Serial.print(F("Authorized cards: "));
  Serial.println((unsigned int)AUTHORIZED_COUNT);

#if ALLOW_ANY_CARD
  Serial.println(F("WARNING: ALLOW_ANY_CARD=1 — bench test only"));
#endif

  beep(70, 0, 1);
  Serial.println(F("Ready. Scan a card."));
}

void loop() {
  if (millis() - lastScanAt < SCAN_COOLDOWN_MS) {
    return;
  }

  if (!rfid.isCard()) {
    return;
  }

  if (!rfid.readCardSerial()) {
    rfid.halt();
    return;
  }

  uint8_t uid[4] = {
    rfid.serNum[0],
    rfid.serNum[1],
    rfid.serNum[2],
    rfid.serNum[3],
  };

  Serial.print(F("Card UID: "));
  printUid(uid);
  Serial.println();

  if (isAuthorized(uid)) {
    grantAccess();
  } else {
    denyAccess();
  }

  rfid.halt();
  lastScanAt = millis();
}
